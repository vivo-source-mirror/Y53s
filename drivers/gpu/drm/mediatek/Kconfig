## drivers/gpu/drm/mediatek/Kconfig
```kconfig
config DRM_MEDIATEK
	tristate "DRM Support for Mediatek SoCs"
	depends on DRM
	depends on COMMON_CLK
	depends on HAVE_ARM_SMCCC
	depends on OF
	select DRM_GEM_CMA_HELPER
	select DRM_KMS_HELPER
	select DRM_MIPI_DSI
	select DRM_PANEL
	select MEMORY
	select MTK_SMI
        select FONT_SUPPORT
	select GENERIC_PHY
	help
	  Choose this option if you have a Mediatek SoCs.
	  The module will be called mediatek-drm
	  This driver provides kernel mode setting and
	  buffer management to userspace.

config DRM_MEDIATEK_HDMI
	tristate "DRM HDMI Support for Mediatek SoCs"
	depends on DRM_MEDIATEK
	select SND_SOC_HDMI_CODEC if SND_SOC
	select GENERIC_PHY
	help
	  DRM/KMS HDMI driver for Mediatek SoCs

config MTK_PQ_COLOR_MODE
	string "Config PQ_COLOR_MODE (MDP & DISP COLOR on/off)"
	default "DISP"
	help
	  This control mdp color on/off and disp color on/off
	  if value equals to DISP, only display color is on.
	  if value equals to MDP, only mdp color is on.
	  if value equals to DISP_MDP, mdp and display color are both on.
	  if value equals to OFF, mdp and display color are both off.

config DRM_MTK_SHADOW_REGISTER_SUPPORT
	bool "DRM shadow register Support for Mediatek SoCs"
	depends on DRM_MEDIATEK
	help
	  DRM shadow register Support for Mediatek SoCs.
	  define CONFIG_DRM_MTK_SHADOW_REGISTER_SUPPORT to
	  enable Shadow Register on display.
	  This feature will de-risk configuration time shortage.
	  If you want to use Shadow Register on display,
	  please make sure it is Y in xxx_defconfig.
	  This feature depends on Mediatek SoCs HW spec.
	  If unsure, set N.

config LCM_PANEL_FPS_120Hz
	bool "LCM PANEL FPS"
	default n
	help
	  for high panel fps

config LCM_ESD_CHECK_RELOAD_FW
	bool "ESD RELOAD FW"
	default n
	help
	  for esd recovery to reload firmware

config VIVO_BACKLIGHT_SUPPORT_LM3697
	bool "LM3697(KTD3137) Support"
	default n
	---help---
	  LED driver for lm3697(KTD3137) support.
	  Set y to support.
	  Set n to disable.

config VIVO_LCM_DCDC_SUPPORT
	bool "LCM DCDC Support"
	default n
	---help---
	  DCDC driver for LCM support.
	  Set y to support.
	  Set n to disable.
config DRM_PANEL_PD1986_TM_NT6672C_FHDP_VDO120HZ
	bool "TM  FHD+ 120 video mode panel"
	default n
	help
	  the first panel for pd1986
config DRM_PANEL_PD1986_TRULY_NT6672C_FHDP_VDO120HZ
	bool "TRULY  FHD+ 120 video mode panel"
	default n
	help
	  the second panel for pd1986

config DRM_PANEL_PD1986_TRULY_NT6672C_FHDP_VDO144HZ
	bool "TRULY  FHD+ 144 video mode panel"
	default n
	help
	  the third panel for pd1986

config DRM_PANEL_PD1986_TM_NT6672C_FHDP_VDO144HZ
	bool "TM  FHD+ 144 video mode panel"
	default n
	help
	  the fourth panel for pd1986

config VIVO_LCM_WHITE_LIST_BW_144HZ
	bool "144HZ LCM white list"
	default n
	help
	  for 144HZ panel

config VIVO_READ_DDIC_REG
	bool "read ddic reg support"
	depends on DRM_MEDIATEK
	default n
	help
	  for read ddic reg

config DRM_MTK_DISABLE_AEE_LAYER
	bool "Disable AEE Layer for the customer who don't want to produce AEE"
	help
	  Disable AEE Layer if you do not want to produce AEE.
	  Default Mediatek SoCs will produce AEE when exception occurred.
	  if this value is y, will not produce AEE.
	  if this value is n, will produce AEE.
	  If you do not produce AEE, please set it to Y in xxx_defconfig.
```

## drivers/info/Kconfig
```kconfig
menu "BBK Driver Info class support"
config BBK_INFO
	tristate "BBK Info class config"
	help
	  Say Y here to enable driver info class support.
if BBK_INFO

config BBK_DRIVER_INFO
	tristate "GPIO Driver Info"
	help
	  Say Y here to enable bbk driver info interface.

config BBK_CARD_DETECT
	tristate "GPIO Driver Info"
	help
	  Say Y here to enable bbk driver info interface.
endif # SWITCH

endmenu
```

## drivers/input/fingerprint/Kconfig
```kconfig
menuconfig BBK_FINGERPRINT
	tristate "BBK FINGERPRINT support"
	help
	  Say Y here to enable fingerprint

if BBK_FINGERPRINT
config BBK_FP_MODULE
	bool "BBK fingerprint modules"
	help
		Say Y here to enable fingerprint modules
config BBK_FP_ID
	tristate "detect fingerprint id"
	help
	  there is nothing for help!
config BBK_FP_HBM_INPUT
	tristate "BBK FP HBM INPUT support"
	help
	  Say Y here to enable switch class support.

source "drivers/input/fingerprint/gf9518/Kconfig"
source "drivers/input/fingerprint/gf3208/Kconfig"
source "drivers/input/fingerprint/fpc1511/Kconfig"
source "drivers/input/fingerprint/gsl7001/Kconfig"
endif
```

## drivers/input/fingerprint/fpc1511/Kconfig
```kconfig
#
# FPC sensors
#

config BBK_FPC1511
	tristate "FPC1511 fingerprint sensor IRQ support"
	help
		If you say yes here you get IRQ support for the FPC1511 family
		of fingerprint sensors from Fingerprint Cards (FPC).
```

## drivers/input/fingerprint/gf3208/Kconfig
```kconfig
config BBK_GF3208
  tristate "GOODIX OEM fingerprint BBK_GF3208 support"
  default n
  help
    Goodix Fingerprint chip GF516/GF318/GF316M/GF5116M/GF5216C/GF616M/GF318M TEE driver
```

## drivers/input/fingerprint/gf9518/Kconfig
```kconfig
config BBK_GF9518
  tristate "GOODIX OEM fingerprint BBK_GF9518 support"
  default n
  help
    Goodix Fingerprint chip GF516/GF318/GF316M/GF5116M/GF5216C/GF616M/GF318M TEE driver
```

## drivers/input/fingerprint/gsl7001/Kconfig
```kconfig
#
# Silead Fingerprint driver configuration
#
 
config BBK_GSL7001
	tristate "SILEAD OEM fingerprint BBK_GSL7001 support"
	default n
	help
	  This supports Silead spi Fingerprint drivers.
```

## drivers/input/touchscreen/drivers/Kconfig
```kconfig
#
# Touchscreen driver configuration
#
config VIVO_TS
       tristate "vivo touchscreen driver"
       default y
       help
           Say Y here if you have vivo touchscreen driver.
           If unsure, say N.
```

## drivers/misc/mediatek/lcm/Kconfig
```kconfig
config MTK_LCM
	bool "Enable LCM driver"
	default n
	help
	  define LCM driver config to enable LCM driver.
	  To set LCM driver which you choose avoid cannot driver LCM.
	  Please make sure CONFIG_MTK_LCM in xxxxxx_defconfig.mk.
	  And also make sure true on in ProjectConfig.mk

config CUSTOM_KERNEL_LCM
	string "define mediatek kernel LCM driver"
	help
	  To choose kernel LCM driver name.
	  This config is to select which LCM driver you want to use.
	  Please make sure CUSTOME_KERNEL_LCM in xxxxx_defconfig.mk.
	  And also make sure turn on in ProjectConfig.mk

config MTK_LCM_DEVICE_TREE_SUPPORT
	bool "support LCM device tree connect with display drivers"
	help
	  Decide whether to support LCM device tree based configuration.
	  This feature requires the connection between display driver and LCM devices.
	  Please also turn on MTK_LCM_DEVICE_TREE_SUPPORT in ProjectConfig.mk.
	  If not define MTK_LCM_DEVICE_TREE_SUPPORT
	  there will not connect between display driver and LCM devices.

config VIVO_MT6360_LDO1_SKIP_DISABLE
	bool "Skip MT6360_LDO1 to disalbe for lcm vci on boot"
	default n
	help
	  Select Y to skip to disable for lcm vci on buoot.

config VIVO_LM3697
	bool "LM3697(KTD3137) Support 21MA CURRENT"
	default n
	---help---
	  LED driver for lm3697(KTD3137) support.
	  Set y to support.
	  Set n to disable.

config VIVO_FINGERPRINT_V3
	bool "use fingerprint version 3"
	default n
	help
	  Select Y to use fingerprint version 3
```

## drivers/misc/mediatek/sensor/2.0/Kconfig
```kconfig
config PROXIMITY_UNDERDISPLAY
	bool "config underdisplay proximity"
	default N
	help
	config underdisplay proximity.

source "drivers/misc/mediatek/sensor/2.0/lsm6dsm_secondary/Kconfig"
source "drivers/misc/mediatek/sensor/2.0/test/Kconfig"
```

## drivers/misc/mediatek/sensors-1.0/situation/ambient_light_scene/Kconfig
```kconfig
config MTK_AMBIENT_LIGHT_SCENE_HUB
	bool "ambient light scene for MediaTek package"
	default n
	help
	  A ambient light scene is a device,
	  usually portable and
	  electronic or electromechanical,
	  that detect ambient light status.
```

## drivers/misc/mediatek/sensors-1.0/situation/amd/Kconfig
```kconfig
config MTK_AMD_HUB
	bool "amd hub for MediaTek package"
	default n
	help
	  A amd is a device,
	  usually portable and electronic
	  or electromechanical,
	  that detect device is picked up with 35 degree.
```

## drivers/misc/mediatek/sensors-1.0/situation/angle_direction/Kconfig
```kconfig
config MTK_ANGLE_DIRECTION_HUB
	bool "angle direction hub for MediaTek package"
	default n
	help
	  A angle direction is a device,
	  usually portable and
	  electronic or electromechanical,
	  that detect device's orientation.
```

## drivers/misc/mediatek/sensors-1.0/situation/angle_judge/Kconfig
```kconfig
config MTK_ANGLE_JUDGE_HUB
	bool "angle judge hub for MediaTek package"
	default n
	help
	  A angle judge is a device,
	  usually portable and
	  electronic or electromechanical,
	  that detect device's orientation.
```

## drivers/misc/mediatek/sensors-1.0/situation/dropdown_detect/Kconfig
```kconfig
config MTK_DROPDOWN_DETECT_HUB
	bool "dropdown detect hub for MediaTek package"
	default n
	help
	  A dropdown detect is a device, usually portable
	  and electronic or electromechanical, that detect device's dropdown.
```

## drivers/misc/mediatek/sensors-1.0/situation/putdown_detect/Kconfig
```kconfig
config MTK_PUTDOWN_DETECT_HUB
	bool "putdown detect hub for MediaTek package"
	default n
	help
	  A putdown detect is a device, usually portable
	  and electronic or electromechanical, that detect device's putdown.
```

## drivers/misc/mediatek/sensors-1.0/situation/raiseup_detect/Kconfig
```kconfig
config MTK_RAISEUP_DETECT_HUB
	bool "raiseup detect hub for MediaTek package"
	default n
	help
	  A raiseup detect is a device, usually portable
	  and electronic or electromechanical, that detect device's raiseup.
```

## drivers/misc/mediatek/sensors-1.0/situation/smartprox_detect/Kconfig
```kconfig
config MTK_SMARTPROX_DETECT_HUB
	bool "smartprox detect hub for MediaTek package"
	default n
	help
	  A smartprox detect is a device, usually portable
	  and electronic or electromechanical, that detect device's smartprox.
```

## drivers/misc/mediatek/sensors-1.0/situation/vivomotion_detect/Kconfig
```kconfig
config MTK_VIVOMOTION_DETECT_HUB
	bool "vivomotion detect hub for MediaTek package"
	default n
	help
	  A vivomotion detect is a device, usually portable
	  and electronic or electromechanical, that detect device's vivomotion.
```

## drivers/misc/mediatek/sensors-1.0/situation/window_orientation/Kconfig
```kconfig
config MTK_WINDOW_ORIENTATION_HUB
	bool "window orientation hub for MediaTek package"
	default n
	help
	  A window orientation is a device,
	  usually portable and
	  electronic or electromechanical,
	  that detect window's orientation.
```

## drivers/misc/mediatek/typec/tusb422/Kconfig
```kconfig
config TUSB422
	bool "Enable TUSB422 USB Power Delivery"
	default n

config TUSB422_PAL
	bool "Enable TUSB422 Platform Abstraction Layer"
	default n
	depends on TUSB422
	
config DUAL_ROLE_USB_INTF
	bool "Generic DUAL ROLE sysfs interface"
	help
	  A generic sysfs interface to track and change the state of
	  dual role usb phys. The usb phy drivers can register to
	  this interface to expose it capabilities to the userspace
	  and thereby allowing userspace to change the port mode.
```

## drivers/misc/vivo_vibcam/Kconfig
```kconfig
menu "SOC (System On Chip) specific Drivers"

source "drivers/misc/vivo_vibcam/src/Kconfig"
endmenu
```

## drivers/misc/vivo_vibcam/src/Kconfig
```kconfig
config HALL_MXM1120_UP
        bool "Support for hall sensor"
        help
          This option enabled support for the Hall sensors.
          Say Y to enabled these.

config HALL_MXM1120_DOWN
        bool "Support for hall sensor"
        help
          This option enabled support for the Hall sensors.
          Say Y to enabled these.

config VIVO_VIB8846
        bool "Support for ccm vibrator"
        help
          This option enabled support for the ccm vibrator.
          Say Y to enabled these.

config HALL_IST8801_UP
        bool "Support for hall sensor"
        help
          This option enabled support for the Hall sensors.
          Say Y to enabled these.

config HALL_IST8801_DOWN
        bool "Support for hall sensor"
        help
          This option enabled support for the Hall sensors.
          Say Y to enabled these.
```

## drivers/nfc/sn100/Kconfig
```kconfig
config NFC_SN100
	tristate "QTI NCI based NFC Controller Driver for SN100x"
	depends on I2C
	help
	  NXP SN100 core driver.
	  This driver provides core functionality for NXP SN100 NFC devices.
```
